## build/conf/bblayers.conf
```bitbake
# POKY_BBLAYERS_CONF_VERSION is increased each time build/conf/bblayers.conf
# changes incompatibly
POKY_BBLAYERS_CONF_VERSION = "2"

BBPATH = "${TOPDIR}"
BBFILES ?= ""

BBLAYERS ?= " \
  /home/yongqian/Projects/embedded/poky/meta \
  /home/yongqian/Projects/embedded/poky/meta-poky \
  /home/yongqian/Projects/embedded/poky/meta-yocto-bsp \
  /home/yongqian/Projects/embedded/poky/meta-intelfpga \
  /home/yongqian/Projects/embedded/poky/meta-pyserial \
  /home/yongqian/Projects/embedded/poky/meta-openembedded/meta-oe \
  /home/yongqian/Projects/embedded/poky/meta-openembedded/meta-python \
  /home/yongqian/Projects/embedded/poky/meta-openembedded/meta-webserver \
  /home/yongqian/Projects/embedded/poky/meta-rtlwifi \
  "
```

## meta-pyserial/conf/layer.conf
```bitbake
# We have a conf and classes directory, add to BBPATH
BBPATH .= ":${LAYERDIR}"

# We have recipes-* directories, add to BBFILES
BBFILES += "${LAYERDIR}/recipes-*/*/*.bb \
            ${LAYERDIR}/recipes-*/*/*.bbappend"

BBFILE_COLLECTIONS += "meta-pyserial"
BBFILE_PATTERN_meta-pyserial = "^${LAYERDIR}/"
BBFILE_PRIORITY_meta-pyserial = "6"

LAYERDEPENDS_meta-pyserial = "core"
LAYERSERIES_COMPAT_meta-pyserial = "dunfell"
```

## meta-usbgadget/conf/layer.conf
```bitbake
# We have a conf and classes directory, add to BBPATH
BBPATH .= ":${LAYERDIR}"

# We have recipes-* directories, add to BBFILES
BBFILES += "${LAYERDIR}/recipes-*/*/*.bb \
            ${LAYERDIR}/recipes-*/*/*.bbappend"

BBFILE_COLLECTIONS += "meta-usbgadget"
BBFILE_PATTERN_meta-usbgadget = "^${LAYERDIR}/"
BBFILE_PRIORITY_meta-usbgadget = "9"

LAYERDEPENDS_meta-usbgadget = "core"
LAYERSERIES_COMPAT_meta-usbgadget = "dunfell"
```
